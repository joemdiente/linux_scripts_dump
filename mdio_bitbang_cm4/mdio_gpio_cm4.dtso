/* 
 * Device Tree overlay for MDIO Bitbang using GPIO
 *
 * Pinout:
 *      MDIO - GPIO02 (GPIO Header Pin 3)
 *      MDC - GPIO03 (GPIO Header Pin 5)
 *
 */

/dts-v1/;
/plugin/;

/ {
	compatible = "raspberrypi,4-compute-module", "brcm,bcm2711";

	fragment@0 {
		target-path = "/";
		__overlay__ {
			model = "loaded MDIO Bitbang GPIO driver";
		};
	};

};